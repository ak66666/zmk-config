## config/boards/shields/lily58cirque/Kconfig.shield
```kconfig
# No whitespace after the comma or in your part name!
config SHIELD_LILY58CIRQUE_LEFT
    def_bool $(shields_list_contains,lily58cirque_left)

# No whitespace after the comma or in your part name!
config SHIELD_LILY58CIRQUE_RIGHT
    def_bool $(shields_list_contains,lily58cirque_right)
```

## config/boards/shields/thumbsupv9/Kconfig.defconfig
```kconfig
if SHIELD_THUMBSUP_V9

config ZMK_KEYBOARD_NAME
    default "ThumbsUp_v9"

endif
```

## config/boards/shields/thumbsupv9cirque/Kconfig.defconfig
```kconfig
if SHIELD_THUMBSUPV9CIRQUE

config ZMK_KEYBOARD_NAME
    default "ThumbsUpV9Cirque"

config ZMK_POINTING
    default y

config I2C
	default y

endif
```

## config/boards/shields/thumbsupv9cirque/Kconfig.shield
```kconfig
config SHIELD_THUMBSUPV9CIRQUE
    def_bool $(shields_list_contains,thumbsupv9cirque)
)
```

## config/boards/shields/thumbsupv9cq/Kconfig.defconfig
```kconfig
if SHIELD_THUMBSUPV9cq

config ZMK_KEYBOARD_NAME
    default "ThumbsUpV9cq"

endif
```

## config/boards/shields/thumbsupv9cq~/Kconfig.defconfig
```kconfig
if SHIELD_THUMBSUPV9CQ

config ZMK_KEYBOARD_NAME
    default "ThumbsUpV9Cq"

config I2C
    default y

endif
```

## config/boards/shields/thumbsupv9q/Kconfig.defconfig
```kconfig
if SHIELD_THUMBSUPV9q

config ZMK_KEYBOARD_NAME
    default "ThumbsUpV9q"
 
config I2C
	default y

endif
```

## config/boards/shields/thumbsupv9s/Kconfig.defconfig
```kconfig
if SHIELD_THUMBSUPV9s

config ZMK_KEYBOARD_NAME
    default "ThumbsUpV9s"

endif
```

## config/west.yml
```yaml
# This file specifies the build dependencies for Github Action workflows and
# for local build environments. The workspace has four toplevel directories
# containing the user config, modules, zephy and ZMK.
#
# ZMK-Workspace
# ├── config
# ├── modules
# ├── zephyr
# └── zmk
#
# To create a local build environment, clone this repository and then run the
# following commands from its toplevel directory:
#
# $ west init -l config
# $ west update
# $ west zephyr-export
#
---
manifest:
  defaults:
    remote: urob
    revision: v0.1 # Pin everything to v0.1

  remotes:
    - name: urob
      url-base: https://github.com/urob
    - name: zmkfirmware
      url-base: https://github.com/zmkfirmware
    - name: badjeff
      url-base: https://github.com/badjeff

  projects:
    # This is vanilla ZMK - just using my remote to pin the current state of main,
    # as upstream hasn't yet released a version with mouse.
    - name: zmk
      revision: v0.1+mouse
      import: app/west.yml

    # ZMK modules
    - name: zmk-adaptive-key
      path: modules/zmk/adaptive-key
    - name: zmk-auto-layer
      path: modules/zmk/auto-layer
    - name: zmk-helpers
      path: modules/zmk/helpers
    - name: zmk-leader-key
      revision: v0.1+locality
      path: modules/zmk/leader-key
    - name: zmk-tri-state
      path: modules/zmk/tri-state
    - name: zmk-adns9800-driver
      remote: badjeff
      revision: main
    - name: zmk-pmw3610-driver
      remote: badjeff
      revision: main
    - name: zmk-analog-input-driver
      remote: badjeff
      revision: main
    - name: zmk-behavior-insomnia
      remote: badjeff
      revision: main
    - name: zmk-behavior-key-tempo
      remote: badjeff
      revision: main
    - name: zmk-behavior-mouse-key-toggle
      remote: badjeff
      revision: main
    - name: zmk-input-behavior-listener
      remote: badjeff
      revision: main
    - name: zmk-output-behavior-listener
      remote: badjeff
      revision: main
    - name: zmk-hid-io
      remote: badjeff
      revision: main
    - name: zmk-split-peripheral-input-relay
      remote: badjeff
      revision: main
    - name: zmk-split-peripheral-output-relay
      remote: badjeff
      revision: main
    - name: zmk-split-peripheral-bonding-tweak
      remote: badjeff
      revision: main
    - name: zmk-kscan-blackout
      remote: badjeff
      revision: main
    - name: cirque-input-module
      remote: badjeff
      revision: main

    # Temporarily overload Zephyr until
    # https://github.com/zmkfirmware/zephyr/pull/40 is merged.
    - name: zephyr
      revision: v3.5.0+zmk-fixes
      clone-depth: 1
      import:
        name-blocklist:
          - ci-tools
          - hal_altera
          - hal_cypress
          - hal_infineon
          - hal_microchip
          - hal_nxp
          - hal_openisa
          - hal_silabs
          - hal_xtensa
          - hal_st
          - hal_ti
          - loramac-node
          - mcuboot
          - mcumgr
          - net-tools
          - openthread
          - edtt
          - trusted-firmware-m

  self:
    path: config
```
