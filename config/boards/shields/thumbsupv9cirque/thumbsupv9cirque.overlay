/*
 * Copyright (c) 2020 Pete Johanson
 *
 * SPDX-License-Identifier: MIT
 */

#include "thumbsupv9cirque.dtsi"

&glidepoint  {
    status = "okay";
};

&glidepoint_listener {
    status = "okay";
};
